## boards/arm/nrf51_hackble/Kconfig.board
```kconfig
# Kconfig - nRF51 hackble board configuration
#
# Copyright (c) 2016 Linaro Limited.
#
# SPDX-License-Identifier: Apache-2.0

config BOARD_NRF51_hackble
	bool "nRF51 hackble"
	depends on SOC_NRF51822_QFAA
```

## boards/arm/nrf51_hackble/Kconfig.defconfig
```kconfig
# Kconfig - nRF51 hackble board configuration
#
# Copyright (c) 2016 Linaro Limited.
#
# SPDX-License-Identifier: Apache-2.0

if BOARD_NRF51_hackble

config BOARD
	default nrf51_hackble

if GPIO_NRF5

config GPIO_NRF5_P0
	default y

endif # GPIO_NRF5

if UART_NRF5

config UART_NRF5_GPIO_TX_PIN
	default 13

config UART_NRF5_GPIO_RX_PIN
	default 15

config UART_NRF5_GPIO_RTS_PIN
	default 8

config UART_NRF5_GPIO_CTS_PIN
	default 10

endif # UART_NRF5

endif # BOARD_NRF51_hackble
```
